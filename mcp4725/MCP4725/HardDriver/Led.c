/************************************************************
 * 文件：Led.c

************************************************************/

/************************* 头文件 *************************/

#include "Led.h"

/************************* 宏定义 *************************/

/************************ 变量定义 ************************/

/************************ 函数定义 ************************/

/************************************************************ 
 * 函数:       (void)
 * 说明:       ****函数
 * 输入:       无
 * 输出:       无
 * 返回值:     无
 * 其他:       无
************************************************************/

	void Led_Init(void)
		{
			  // 初始化 GPIOE 时钟
			 rcu_periph_clock_enable(RCU_GPIOC);   
			 gpio_init(GPIOC, GPIO_MODE_OUT_PP, GPIO_OSPEED_50MHZ, GPIO_PIN_1|GPIO_PIN_2);
				// 引脚初始化				
			 gpio_bit_reset(GPIOC, GPIO_PIN_1|GPIO_PIN_2); 
		}

/***********************************************************************
												程序运行状态指示
***********************************************************************/
	void Procedure_Work(uint8_t a)
		{
			if(a==0)
				{
					Mix_LED_ON() ;
				}
			else 
				{
				 Mix_LED_OFF();
				}
		}
	
	
	void ManMode_Work(uint8_t a)
		{
			if(a==0)
				{
					Manual_LED_ON() ;
				}
			else 
				{
				 Manual_LED_OFF();
				}
		}
	
	
	
	void AutoMode_Work(uint8_t a)
		{
			if(a==0)
				{
					Auto_LED_ON() ;
				}
			else 
				{
				 Auto_LED_OFF();
				}
		}

	
/****************************End*****************************/

